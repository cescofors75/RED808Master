## sdkconfig.defaults
```kconfig
# Disable core dump to remove error messages
CONFIG_ESP_COREDUMP_ENABLE_TO_NONE=y
CONFIG_ESP_COREDUMP_ENABLE=n

# PSRAM: allow placing BSS variables in external RAM
# Required for EXT_RAM_BSS_ATTR usage in main.cpp (large Sequencer arrays)
CONFIG_SPIRAM_ALLOW_BSS_SEG_EXTERNAL_MEMORY=y

# WiFi Stability Settings
CONFIG_ESP_WIFI_SOFTAP_BEACON_MAX_LEN=752
CONFIG_ESP_WIFI_MGMT_SBUF_NUM=32
CONFIG_ESP_WIFI_IRAM_OPT=y
CONFIG_ESP_WIFI_RX_IRAM_OPT=y
CONFIG_ESP_WIFI_SLP_IRAM_OPT=n
CONFIG_ESP_WIFI_STA_DISCONNECTED_PM_ENABLE=n

# LWIP TCP/IP optimizations — match build_flags
CONFIG_LWIP_TCP_SYNMAXRTX=6
CONFIG_LWIP_TCP_MSS=1436
CONFIG_LWIP_TCP_SND_BUF_DEFAULT=11440
CONFIG_LWIP_TCP_WND_DEFAULT=11440
CONFIG_LWIP_TCP_RECVMBOX_SIZE=16
CONFIG_LWIP_UDP_RECVMBOX_SIZE=16
CONFIG_LWIP_TCPIP_RECVMBOX_SIZE=48
```
